## hardware/motion-one/firmware/app/dts/bindings/disroop,icm45686.yaml
```yaml
description: TDK ICM-45686 IMU an SPI (schlanker App-Treiber, ohne hal_tdk)
compatible: "disroop,icm45686"
include: spi-device.yaml
properties:
  int1-gpios:
    type: phandle-array
    required: true
    description: INT1 (Push-Pull, aktiv high), FIFO-Watermark und Wake-on-Motion
  int2-gpios:
    type: phandle-array
    required: false
    description: INT2 (Push-Pull, aktiv high), auf V1 verdrahtet, derzeit ungenutzt
```

## hardware/motion-one/firmware/boards/disroop/motion_one/board.yml
```yaml
board:
  name: motion_one
  full_name: Disroop Motion One (Ebyte E73-2G4M08S1C, nRF52840)
  socs:
    - name: nrf52840
```
