## CMakeLists.txt
```
cmake_minimum_required(VERSION 3.20.0)
# Board motion_one liegt unter firmware/boards/disroop/motion_one
list(APPEND BOARD_ROOT ${CMAKE_CURRENT_SOURCE_DIR}/..)
find_package(Zephyr REQUIRED HINTS $ENV{ZEPHYR_BASE})
project(motion_one_fw)

set(FW ${CMAKE_CURRENT_SOURCE_DIR}/..)
target_include_directories(app PRIVATE ${FW}/codec/include ${FW}/fusion/include ${FW}/icm/include ${FW}/power/include src)
target_sources(app PRIVATE
  ${FW}/codec/src/thingy_codec.c
  ${FW}/fusion/src/motion_fusion.c
  ${FW}/icm/src/icm45686.c
  ${FW}/power/src/vbat.c
  ${FW}/power/src/motor_drive.c
  src/main.c src/ble_thingy.c src/imu_task.c src/ui.c src/battery.c src/board_early.c)
```

## prj.conf
```kconfig
CONFIG_FPU=y
CONFIG_LOG=y
CONFIG_SPI=y
CONFIG_PWM=y
CONFIG_ADC=y
CONFIG_POWEROFF=y
CONFIG_MAIN_STACK_SIZE=2048
CONFIG_SYSTEM_WORKQUEUE_STACK_SIZE=2048

CONFIG_BT=y
CONFIG_BT_PERIPHERAL=y
CONFIG_BT_DEVICE_NAME="Thingy"
CONFIG_BT_MAX_CONN=1
CONFIG_BT_BAS=y
# Verbindungsparameter laut BUDGETS: 7.5..15 ms, Latenz 0, Timeout 4 s
CONFIG_BT_PERIPHERAL_PREF_MIN_INT=6
CONFIG_BT_PERIPHERAL_PREF_MAX_INT=12
CONFIG_BT_PERIPHERAL_PREF_LATENCY=0
CONFIG_BT_PERIPHERAL_PREF_TIMEOUT=400
CONFIG_BT_GAP_AUTO_UPDATE_CONN_PARAMS=y
# MTU 247 akzeptieren (Nutzlast bleibt <= 20 B)
CONFIG_BT_L2CAP_TX_MTU=247
CONFIG_BT_BUF_ACL_RX_SIZE=251
CONFIG_BT_BUF_ACL_TX_SIZE=251
CONFIG_BT_CTLR_DATA_LENGTH_MAX=251
# 0 dBm, kein Bonding/SMP
CONFIG_BT_CTLR_TX_PWR_0=y
CONFIG_BT_SMP=n
# Q-02: kein UART, Log nur ueber SEGGER RTT (SWD)
CONFIG_USE_SEGGER_RTT=y
CONFIG_LOG_BACKEND_RTT=y
CONFIG_LOG_BACKEND_UART=n
```

## dts/bindings/disroop,icm45686.yaml
```yaml
description: TDK ICM-45686 IMU an SPI (schlanker App-Treiber, ohne hal_tdk)
compatible: "disroop,icm45686"
include: spi-device.yaml
properties:
  int1-gpios:
    type: phandle-array
    required: true
    description: INT1 (Push-Pull, aktiv high), FIFO-Watermark und Wake-on-Motion
```

## src/main.c
```c
/* Disroop Motion One V1: Thingy:52-kompatible Firmware (nRF52840 + ICM-45686). */
#include <zephyr/kernel.h>
#include <zephyr/logging/log.h>
#include <zephyr/sys/poweroff.h>
#include <zephyr/bluetooth/services/bas.h>
#include "app.h"

LOG_MODULE_REGISTER(main, LOG_LEVEL_INF);

#define BATTERY_PERIOD_S 60u
#define UNDERVOLTAGE_MV 3300u /* BUDGETS, ANNAHME */

static void power_off(const char *why)
{
	LOG_WRN("System OFF: %s", why);
	thingy_led_cmd_t off = {.mode = THINGY_LED_OFF};
	ui_led_apply(&off);
	(void)imu_enter_wake_on_motion();
	(void)ui_arm_button_wakeup();
	sys_poweroff();
}

static void update_battery(void)
{
	const uint16_t mv = battery_read_mv();
	if (mv == 0) {
		return;
	}
	(void)bt_bas_set_battery_level(thingy_battery_percent_from_mv(mv)); /* notify nur bei Aenderung */
	if (mv < UNDERVOLTAGE_MV) {
		power_off("Unterspannung");
	}
}

int main(void)
{
	LOG_INF("Motion One V1 start");
	if (ui_init() || battery_init()) {
		LOG_ERR("UI/Batterie-Init fehlgeschlagen");
	}
	update_battery();
	if (ble_thingy_init()) {
		LOG_ERR("BLE-Init fehlgeschlagen");
		return 0;
	}
	if (imu_task_start()) {
		LOG_ERR("IMU-Init fehlgeschlagen");
	}
	uint32_t t = 0;
	for (;;) {
		k_sleep(K_SECONDS(1));
		if (++t % BATTERY_PERIOD_S == 0) {
			update_battery();
		}
		if (!ble_is_connected() && imu_at_rest_for_s(REST_SLEEP_S)) {
			power_off("Ruhe ohne Verbindung");
		}
	}
}
```

## src/app.h
```c
/* Ports zwischen den App-Modulen (Zephyr-Adapter). */
#ifndef APP_H
#define APP_H

#include <stdbool.h>
#include <stdint.h>
#include "thingy_codec.h"

#define IMU_ODR_HZ 400u
#define REST_SLEEP_S 60u          /* ANNAHME: Ruhe ohne Verbindung bis System-OFF */
#define WOM_THRESHOLD_MG 100u     /* ANNAHME */
#define NOTIFY_BUDGET_PER_S 200u  /* REQ/BUDGETS: Summe Notifications <= 200/s */

/* ble_thingy.c */
int ble_thingy_init(void);
bool ble_is_connected(void);
void ble_get_motion_config(thingy_motion_config_t *cfg);
bool ble_motion_wanted(void);
void ble_publish_motion(const float q[4], float roll, float pitch, float yaw, const thingy_raw_motion_t *raw,
			const thingy_raw_hr_t *hr);
void ble_publish_button(bool pressed);
void ble_publish_speaker_done(void);
void ble_publish_ui_ext(const ui_ext_state_t *s); /* EF680380, ui_svc.attrs[7] */

/* imu_task.c */
int imu_task_start(void);
void imu_request_calibration(void);
bool imu_at_rest_for_s(uint32_t seconds);
int imu_enter_wake_on_motion(void);

/* ui.c */
int ui_init(void);
void ui_led_apply(const thingy_led_cmd_t *cmd);
void ui_speaker_tone(const thingy_speaker_tone_t *tone);
void ui_vibrate_ms(uint32_t ms);
int ui_arm_button_wakeup(void);

/* ext.c (r4 J5 Bedienplatine) */
int ext_input_start(void);
void ext_input_suspend(void);
void ext_publish_stick(int8_t x_pct, int8_t y_pct, bool btn);
void ext_publish_touch(bool down);
void ext_ui_subscribed(void); /* CCC EF680380 aktiviert */

/* battery.c */
int battery_init(void);
uint16_t battery_read_mv(void);
uint16_t battery_last_mv(void); /* letzte Messung, ohne ADC-Zugriff; 0 = keine */

#endif
```

## src/battery.c
```c
/* Akkuspannung: VBAT_EN an, >= 25 ms warten, SAADC lesen, VBAT_EN aus (Logik in power/vbat.c, Host-getestet). */
#include <zephyr/kernel.h>
#include <zephyr/drivers/adc.h>
#include <zephyr/drivers/gpio.h>
#include "app.h"
#include "vbat.h"

#define USER DT_PATH(zephyr_user)
static const struct adc_dt_spec ch = ADC_DT_SPEC_GET(USER);
static const struct gpio_dt_spec en = GPIO_DT_SPEC_GET(USER, vbat_en_gpios);

static int z_en(void *c, int on) { (void)c; return gpio_pin_set_dt(&en, on); }
static void z_sleep(void *c, uint32_t ms) { (void)c; k_msleep((int32_t)ms); }
static int z_adc(void *c, int32_t *mv)
{
	(void)c;
	int16_t raw;
	struct adc_sequence seq = {.buffer = &raw, .buffer_size = sizeof raw};
	int rc = adc_sequence_init_dt(&ch, &seq);
	if (rc == 0) {
		rc = adc_read_dt(&ch, &seq);
	}
	if (rc == 0) {
		*mv = raw;
		rc = adc_raw_to_millivolts_dt(&ch, mv);
	}
	return rc;
}

static const vbat_port_t port = {.ctx = NULL, .set_enable = z_en, .sleep_ms = z_sleep, .read_adc_mv = z_adc};

int battery_init(void)
{
	if (!adc_is_ready_dt(&ch) || !gpio_is_ready_dt(&en)) {
		return -ENODEV;
	}
	int rc = gpio_pin_configure_dt(&en, GPIO_OUTPUT_INACTIVE);
	return rc ? rc : adc_channel_setup_dt(&ch);
}

uint16_t battery_read_mv(void)
{
	uint16_t mv = 0;
	(void)vbat_measure(&port, DT_PROP(USER, vbat_divider_num), DT_PROP(USER, vbat_divider_den), &mv);
	return mv;
}
```

## src/ble_thingy.c
```c
/* GATT-Profil wie Thingy:52 (docs/protocol.md, INTERFACES.json ble_profile). Adapter: Zephyr BT. */
#include <string.h>
#include <zephyr/kernel.h>
#include <zephyr/logging/log.h>
#include <zephyr/bluetooth/bluetooth.h>
#include <zephyr/bluetooth/conn.h>
#include <zephyr/bluetooth/gatt.h>
#include <zephyr/bluetooth/uuid.h>
#include "app.h"

LOG_MODULE_REGISTER(ble, LOG_LEVEL_INF);

#define TUUID(n) BT_UUID_DECLARE_128(BT_UUID_128_ENCODE(0xEF680000u + (n), 0x9B35, 0x4933, 0x9B10, 0x52FFA9740042))
#define RD BT_GATT_PERM_READ
#define WR BT_GATT_PERM_WRITE

static struct bt_conn *conn_cur;
static K_MUTEX_DEFINE(cfg_lock);
static thingy_motion_config_t motion_cfg;
static thingy_env_config_t env_cfg;
static thingy_sound_config_t sound_cfg;
static thingy_led_cmd_t led_cmd = {.mode = THINGY_LED_OFF};
static uint8_t button_state;
static const char dev_name[] = "Thingy";

static ssize_t att_status(thingy_status_t s)
{
	return s == THINGY_ERR_LEN ? BT_GATT_ERR(BT_ATT_ERR_INVALID_ATTRIBUTE_LEN)
				   : BT_GATT_ERR(BT_ATT_ERR_VALUE_NOT_ALLOWED);
}

static ssize_t rd_name(struct bt_conn *c, const struct bt_gatt_attr *a, void *buf, uint16_t len, uint16_t off)
{
	return bt_gatt_attr_read(c, a, buf, len, off, dev_name, sizeof dev_name - 1);
}

static ssize_t rd_motion_cfg(struct bt_conn *c, const struct bt_gatt_attr *a, void *buf, uint16_t len, uint16_t off)
{
	uint8_t v[THINGY_MOTION_CONFIG_LEN];
	k_mutex_lock(&cfg_lock, K_FOREVER);
	(void)thingy_encode_motion_config(&motion_cfg, v, sizeof v);
	k_mutex_unlock(&cfg_lock);
	return bt_gatt_attr_read(c, a, buf, len, off, v, sizeof v);
}

static ssize_t wr_motion_cfg(struct bt_conn *c, const struct bt_gatt_attr *a, const void *buf, uint16_t len,
			     uint16_t off, uint8_t flags)
{
	thingy_motion_config_t n;
	const thingy_status_t s = off ? THINGY_ERR_LEN : thingy_parse_motion_config(buf, len, &n);
	if (s != THINGY_OK) {
		return att_status(s);
	}
	k_mutex_lock(&cfg_lock, K_FOREVER);
	motion_cfg = n;
	k_mutex_unlock(&cfg_lock);
	LOG_INF("motion_freq_hz=%u", n.motion_freq_hz);
	return len;
}

static ssize_t rd_env_cfg(struct bt_conn *c, const struct bt_gatt_attr *a, void *buf, uint16_t len, uint16_t off)
{
	return bt_gatt_attr_read(c, a, buf, len, off, env_cfg.raw, sizeof env_cfg.raw);
}

static ssize_t wr_env_cfg(struct bt_conn *c, const struct bt_gatt_attr *a, const void *buf, uint16_t len,
			  uint16_t off, uint8_t flags)
{
	const thingy_status_t s = off ? THINGY_ERR_LEN : thingy_parse_env_config(buf, len, &env_cfg);
	return s == THINGY_OK ? (ssize_t)len : att_status(s);
}

static ssize_t rd_sound_cfg(struct bt_conn *c, const struct bt_gatt_attr *a, void *buf, uint16_t len, uint16_t off)
{
	const uint8_t v[2] = {sound_cfg.speaker_mode, sound_cfg.mic_mode};
	return bt_gatt_attr_read(c, a, buf, len, off, v, sizeof v);
}

static ssize_t wr_sound_cfg(struct bt_conn *c, const struct bt_gatt_attr *a, const void *buf, uint16_t len,
			    uint16_t off, uint8_t flags)
{
	const thingy_status_t s = off ? THINGY_ERR_LEN : thingy_parse_sound_config(buf, len, &sound_cfg);
	return s == THINGY_OK ? (ssize_t)len : att_status(s);
}

static ssize_t wr_speaker(struct bt_conn *c, const struct bt_gatt_attr *a, const void *buf, uint16_t len,
			  uint16_t off, uint8_t flags)
{
	thingy_speaker_tone_t t;
	const thingy_status_t s = off ? THINGY_ERR_LEN : thingy_parse_speaker_tone(buf, len, &t);
	if (s != THINGY_OK) {
		return att_status(s);
	}
	if (sound_cfg.speaker_mode != 1) {
		return BT_GATT_ERR(BT_ATT_ERR_VALUE_NOT_ALLOWED); /* nur Frequenzmodus implementiert */
	}
	ui_speaker_tone(&t);
	return len;
}

static ssize_t rd_led(struct bt_conn *c, const struct bt_gatt_attr *a, void *buf, uint16_t len, uint16_t off)
{
	uint8_t v[5];
	const size_t n = thingy_encode_led(&led_cmd, v, sizeof v);
	return bt_gatt_attr_read(c, a, buf, len, off, v, n);
}

static ssize_t wr_led(struct bt_conn *c, const struct bt_gatt_attr *a, const void *buf, uint16_t len,
		      uint16_t off, uint8_t flags)
{
	thingy_led_cmd_t n;
	const thingy_status_t s = off ? THINGY_ERR_LEN : thingy_parse_led(buf, len, &n);
	if (s != THINGY_OK) {
		return att_status(s);
	}
	led_cmd = n;
	ui_led_apply(&n);
	return len;
}

static ssize_t rd_button(struct bt_conn *c, const struct bt_gatt_attr *a, void *buf, uint16_t len, uint16_t off)
{
	return bt_gatt_attr_read(c, a, buf, len, off, &button_state, 1);
}

static void ccc_changed(const struct bt_gatt_attr *attr, uint16_t value)
{
	ARG_UNUSED(attr);
	LOG_DBG("CCC %u", value);
}

#define NOTIFY_CHR(uuid) \
	BT_GATT_CHARACTERISTIC(uuid, BT_GATT_CHRC_NOTIFY, BT_GATT_PERM_NONE, NULL, NULL, NULL), \
	BT_GATT_CCC(ccc_changed, RD | WR)

/* Konfiguration: advertised, Geraetename */
BT_GATT_SERVICE_DEFINE(cfg_svc, BT_GATT_PRIMARY_SERVICE(TUUID(0x0100)),
	BT_GATT_CHARACTERISTIC(TUUID(0x0101), BT_GATT_CHRC_READ, RD, rd_name, NULL, NULL));

/* Environment minimal: nur EF680206 (Bridge liest/schreibt sie beim Konfigurieren) */
BT_GATT_SERVICE_DEFINE(env_svc, BT_GATT_PRIMARY_SERVICE(TUUID(0x0200)),
	BT_GATT_CHARACTERISTIC(TUUID(0x0206), BT_GATT_CHRC_READ | BT_GATT_CHRC_WRITE, RD | WR, rd_env_cfg,
			       wr_env_cfg, NULL));

/* UI: [1] decl 0301, [2] LED, [3] decl 0302, [4] Button, [5] CCC */
BT_GATT_SERVICE_DEFINE(ui_svc, BT_GATT_PRIMARY_SERVICE(TUUID(0x0300)),
	BT_GATT_CHARACTERISTIC(TUUID(0x0301), BT_GATT_CHRC_READ | BT_GATT_CHRC_WRITE, RD | WR, rd_led, wr_led,
			       NULL),
	BT_GATT_CHARACTERISTIC(TUUID(0x0302), BT_GATT_CHRC_READ | BT_GATT_CHRC_NOTIFY, RD, rd_button, NULL,
			       NULL),
	BT_GATT_CCC(ccc_changed, RD | WR));

/* Motion: [2] 0401, [4] 0404, [7] 0406, [10] 0407, [13] 0409, [16] 0480 */
BT_GATT_SERVICE_DEFINE(motion_svc, BT_GATT_PRIMARY_SERVICE(TUUID(0x0400)),
	BT_GATT_CHARACTERISTIC(TUUID(0x0401), BT_GATT_CHRC_READ | BT_GATT_CHRC_WRITE, RD | WR, rd_motion_cfg,
			       wr_motion_cfg, NULL),
	NOTIFY_CHR(TUUID(0x0404)), NOTIFY_CHR(TUUID(0x0406)), NOTIFY_CHR(TUUID(0x0407)),
	NOTIFY_CHR(TUUID(0x0409)), NOTIFY_CHR(TUUID(0x0480)));

/* Sound: [2] 0501, [4] 0502, [6] 0503 */
BT_GATT_SERVICE_DEFINE(sound_svc, BT_GATT_PRIMARY_SERVICE(TUUID(0x0500)),
	BT_GATT_CHARACTERISTIC(TUUID(0x0501), BT_GATT_CHRC_READ | BT_GATT_CHRC_WRITE, RD | WR, rd_sound_cfg,
			       wr_sound_cfg, NULL),
	BT_GATT_CHARACTERISTIC(TUUID(0x0502), BT_GATT_CHRC_WRITE_WITHOUT_RESP | BT_GATT_CHRC_WRITE, WR, NULL,
			       wr_speaker, NULL),
	NOTIFY_CHR(TUUID(0x0503)));

enum { M_QUAT, M_RAW, M_EULER, M_HEADING, M_HR, M_COUNT };
static const struct bt_gatt_attr *const motion_attr[M_COUNT] = {
	&motion_svc.attrs[4], &motion_svc.attrs[7], &motion_svc.attrs[10], &motion_svc.attrs[13],
	&motion_svc.attrs[16]};

static const struct bt_data ad[] = {
	BT_DATA_BYTES(BT_DATA_FLAGS, (BT_LE_AD_GENERAL | BT_LE_AD_NO_BREDR)),
	BT_DATA_BYTES(BT_DATA_UUID128_ALL,
		      BT_UUID_128_ENCODE(0xEF680100, 0x9B35, 0x4933, 0x9B10, 0x52FFA9740042)),
};
static const struct bt_data sd[] = {
	BT_DATA(BT_DATA_NAME_COMPLETE, dev_name, sizeof dev_name - 1),
};

static void adv_start(struct k_work *w)
{
	ARG_UNUSED(w);
	const int err = bt_le_adv_start(BT_LE_ADV_CONN_FAST_1, ad, ARRAY_SIZE(ad), sd, ARRAY_SIZE(sd));
	if (err && err != -EALREADY) {
		LOG_ERR("adv %d", err);
	}
}
static K_WORK_DEFINE(adv_work, adv_start);

static void connected(struct bt_conn *c, uint8_t err)
{
	if (err) {
		return;
	}
	conn_cur = bt_conn_ref(c);
	LOG_INF("verbunden");
}

static void disconnected(struct bt_conn *c, uint8_t reason)
{
	if (conn_cur == c) {
		bt_conn_unref(conn_cur);
		conn_cur = NULL;
	}
	LOG_INF("getrennt 0x%02x", reason);
}

static void recycled(void)
{
	k_work_submit(&adv_work);
}

static void le_param_updated(struct bt_conn *c, uint16_t interval, uint16_t latency, uint16_t timeout)
{
	LOG_INF("Intervall %u x 1.25 ms, Latenz %u, Timeout %u", interval, latency, timeout);
}

BT_CONN_CB_DEFINE(conn_cb) = {
	.connected = connected,
	.disconnected = disconnected,
	.recycled = recycled,
	.le_param_updated = le_param_updated,
};

int ble_thingy_init(void)
{
	thingy_motion_config_default(&motion_cfg);
	thingy_env_config_default(&env_cfg);
	thingy_sound_config_default(&sound_cfg);
	const int err = bt_enable(NULL);
	if (err) {
		return err;
	}
	k_work_submit(&adv_work);
	return 0;
}

bool ble_is_connected(void)
{
	return conn_cur != NULL;
}

void ble_get_motion_config(thingy_motion_config_t *cfg)
{
	k_mutex_lock(&cfg_lock, K_FOREVER);
	*cfg = motion_cfg;
	k_mutex_unlock(&cfg_lock);
}

static bool subscribed(const struct bt_gatt_attr *attr)
{
	struct bt_conn *c = conn_cur;
	return c != NULL && bt_gatt_is_subscribed(c, attr, BT_GATT_CCC_NOTIFY);
}

bool ble_motion_wanted(void)
{
	for (int i = 0; i < M_COUNT; i++) {
		if (subscribed(motion_attr[i])) {
			return true;
		}
	}
	return false;
}

/* Wird mit motion_freq_hz aufgerufen; Dezimierung so, dass Summe der Notifications <= 200/s bleibt. */
void ble_publish_motion(const float q[4], float roll, float pitch, float yaw, const thingy_raw_motion_t *raw,
			const thingy_raw_hr_t *hr)
{
	static uint32_t tick;
	bool sub[M_COUNT];
	uint32_t n = 0;
	for (int i = 0; i < M_COUNT; i++) {
		sub[i] = subscribed(motion_attr[i]);
		n += sub[i];
	}
	if (n == 0) {
		return;
	}
	thingy_motion_config_t cfg;
	ble_get_motion_config(&cfg);
	const uint32_t want = (uint32_t)cfg.motion_freq_hz * n;
	const uint32_t every = (want + NOTIFY_BUDGET_PER_S - 1) / NOTIFY_BUDGET_PER_S; /* BERECHNUNG ceil */
	if ((tick++ % (every ? every : 1)) != 0) {
		return;
	}
	uint8_t b[THINGY_RAW_MOTION_LEN];
	struct bt_conn *c = conn_cur;
	if (sub[M_QUAT] && thingy_encode_quaternion(q, b, sizeof b)) {
		(void)bt_gatt_notify(c, motion_attr[M_QUAT], b, THINGY_QUATERNION_LEN);
	}
	if (sub[M_RAW] && thingy_encode_raw_motion(raw, b, sizeof b)) {
		(void)bt_gatt_notify(c, motion_attr[M_RAW], b, THINGY_RAW_MOTION_LEN);
	}
	if (sub[M_EULER] && thingy_encode_euler(roll, pitch, yaw, b, sizeof b)) {
		(void)bt_gatt_notify(c, motion_attr[M_EULER], b, THINGY_EULER_LEN);
	}
	if (sub[M_HEADING] && thingy_encode_heading(yaw, b, sizeof b)) {
		(void)bt_gatt_notify(c, motion_attr[M_HEADING], b, THINGY_HEADING_LEN);
	}
	if (sub[M_HR] && thingy_encode_raw_hr(hr, b, sizeof b)) {
		(void)bt_gatt_notify(c, motion_attr[M_HR], b, THINGY_RAW_HR_LEN);
	}
}

void ble_publish_button(bool pressed)
{
	(void)thingy_encode_button(pressed, &button_state, 1);
	if (subscribed(&ui_svc.attrs[4])) {
		(void)bt_gatt_notify(conn_cur, &ui_svc.attrs[4], &button_state, 1);
	}
}

void ble_publish_speaker_done(void)
{
	const uint8_t finished = 0x00; /* ANNAHME Thingy-Status "finished" */
	if (subscribed(&sound_svc.attrs[6])) {
		(void)bt_gatt_notify(conn_cur, &sound_svc.attrs[6], &finished, 1);
	}
}
```

## src/board_early.c
```c
/* Frueheste Pin-Initialisierung (PCB-Hinweis 2026-11-07): IMU-CS sofort high (kein Pull-up auf V1),
 * VBAT_EN low (Teiler aus). Laeuft in PRE_KERNEL_1 Prioritaet 0, vor GPIO- und SPI-Treiber. */
#include <zephyr/init.h>
#include <zephyr/devicetree.h>
#include <hal/nrf_gpio.h>

#define CS_SPEC DT_GPIO_PIN_BY_IDX(DT_NODELABEL(spi3), cs_gpios, 0)
#define CS_PORT DT_PROP(DT_GPIO_CTLR_BY_IDX(DT_NODELABEL(spi3), cs_gpios, 0), port)
#define EN_PIN DT_GPIO_PIN(DT_PATH(zephyr_user), vbat_en_gpios)
#define EN_PORT DT_PROP(DT_GPIO_CTLR(DT_PATH(zephyr_user), vbat_en_gpios), port)

static int board_early_init(void)
{
	const uint32_t cs = NRF_GPIO_PIN_MAP(CS_PORT, CS_SPEC);
	const uint32_t en = NRF_GPIO_PIN_MAP(EN_PORT, EN_PIN);
	nrf_gpio_pin_set(cs);
	nrf_gpio_cfg_output(cs);
	nrf_gpio_pin_clear(en);
	nrf_gpio_cfg_output(en);
	return 0;
}

SYS_INIT(board_early_init, PRE_KERNEL_1, 0);
```

## src/ext.c
```c
/* r4 J5-Erweiterung (Zephyr-Adapter; Logik in input/src/ext_input.c, Host-getestet).
 * Stick X/Y (AIN5/AIN6) nur bei Verbindung und vorhandener Bedienplatine abtasten, 20 Hz bei Bewegung,
 * sonst 2 Hz. Touch EXT5 per Flanken-Interrupt, entprellt, Flankenflut sperrt. */
#include <zephyr/kernel.h>
#include <zephyr/logging/log.h>
#include <zephyr/drivers/adc.h>
#include <zephyr/drivers/gpio.h>
#include "app.h"
#include "ext_input.h"

LOG_MODULE_REGISTER(ext, LOG_LEVEL_INF);

#define USER DT_PATH(zephyr_user)
static const struct adc_dt_spec ax = ADC_DT_SPEC_GET_BY_IDX(USER, 1);
static const struct adc_dt_spec ay = ADC_DT_SPEC_GET_BY_IDX(USER, 2);
static const struct gpio_dt_spec ext4 = GPIO_DT_SPEC_GET(USER, ext4_gpios);
static const struct gpio_dt_spec ext5 = GPIO_DT_SPEC_GET(USER, ext5_gpios);
static const struct device *const gpio0 = DEVICE_DT_GET(DT_NODELABEL(gpio0));
#define PIN_EXT1 29 /* P0.29/AIN5, nur fuer Praesenzpruefung (Pull kurzzeitig) */

static stick_axis_cal_t cx, cy;
static stick_poll_t poll;
static touch_t touch;
static bool present;
static struct gpio_callback touch_cb;

static int read_mv(const struct adc_dt_spec *ch, uint16_t *mv)
{
	int16_t raw;
	struct adc_sequence seq = {.buffer = &raw, .buffer_size = sizeof raw};
	int rc = adc_sequence_init_dt(ch, &seq);
	rc = rc ? rc : adc_read_dt(ch, &seq);
	int32_t v = raw;
	rc = rc ? rc : adc_raw_to_millivolts_dt(ch, &v);
	*mv = rc || v < 0 ? 0 : (uint16_t)MIN(v, UINT16_MAX);
	return rc;
}

/* EXT1 mit internem Pull-up bzw. Pull-down (13 kOhm) messen: offen folgt dem Pull, Stick nicht. */
static bool probe_board(void)
{
	uint16_t up = 0, dn = 0;
	(void)gpio_pin_configure(gpio0, PIN_EXT1, GPIO_INPUT | GPIO_PULL_UP);
	k_msleep(1);
	(void)read_mv(&ax, &up);
	(void)gpio_pin_configure(gpio0, PIN_EXT1, GPIO_INPUT | GPIO_PULL_DOWN);
	k_msleep(1);
	(void)read_mv(&ax, &dn);
	(void)gpio_pin_configure(gpio0, PIN_EXT1, GPIO_DISCONNECTED);
	LOG_INF("J5-Probe EXT1 up %u mV, down %u mV", up, dn);
	return ext_board_present(up, dn);
}

static void stick_poll(struct k_work *w);
static K_WORK_DELAYABLE_DEFINE(stick_work, stick_poll);

static void stick_poll(struct k_work *w)
{
	ARG_UNUSED(w);
	if (!ble_is_connected()) {
		k_work_schedule(&stick_work, K_SECONDS(1)); /* keine ADC-Abtastung ohne Abnehmer */
		return;
	}
	uint16_t mx = 0, my = 0;
	(void)read_mv(&ax, &mx);
	(void)read_mv(&ay, &my);
	const int8_t x = stick_axis_scale(&cx, mx, EXT_DEADZONE_PCT);
	const int8_t y = stick_axis_scale(&cy, my, EXT_DEADZONE_PCT);
	const bool btn = gpio_pin_get_dt(&ext4) > 0;
	static int8_t lx, ly;
	static bool lb;
	if (x != lx || y != ly || btn != lb) {
		lx = x; ly = y; lb = btn;
		ext_publish_stick(x, y, btn);
	}
	k_work_schedule(&stick_work, K_MSEC(stick_next_poll_ms(&poll, x, y, btn || touch.stable, k_uptime_get_32())));
}

static void touch_eval(struct k_work *w);
static K_WORK_DELAYABLE_DEFINE(touch_work, touch_eval);

static void touch_eval(struct k_work *w)
{
	ARG_UNUSED(w);
	const touch_evt_t e = touch_update(&touch, gpio_pin_get_dt(&ext5) > 0, k_uptime_get_32());
	if (e != TOUCH_EVT_NONE) {
		ext_publish_touch(e == TOUCH_EVT_DOWN);
	}
	if (touch.locked || touch.raw != touch.stable) {
		k_work_reschedule(&touch_work, K_MSEC(touch.locked ? 1000 : TOUCH_DEBOUNCE_MS));
	}
}

static void touch_isr(const struct device *d, struct gpio_callback *cb, uint32_t pins)
{
	ARG_UNUSED(d); ARG_UNUSED(cb); ARG_UNUSED(pins);
	(void)touch_update(&touch, gpio_pin_get_dt(&ext5) > 0, k_uptime_get_32()); /* Flanke zaehlen */
	k_work_reschedule(&touch_work, K_MSEC(TOUCH_DEBOUNCE_MS));
}

int ext_input_start(void)
{
	stick_axis_cal_init(&cx);
	stick_axis_cal_init(&cy);
	touch_init(&touch);
	if (!adc_is_ready_dt(&ax) || !gpio_is_ready_dt(&ext4) || !gpio_is_ready_dt(&ext5)) {
		return -ENODEV;
	}
	int rc = adc_channel_setup_dt(&ax);
	rc = rc ? rc : adc_channel_setup_dt(&ay);
	rc = rc ? rc : gpio_pin_configure_dt(&ext4, GPIO_INPUT);
	rc = rc ? rc : gpio_pin_configure_dt(&ext5, GPIO_INPUT);
	if (rc) {
		return rc;
	}
	present = probe_board();
	if (present) {
		uint16_t sx[8], sy[8]; /* Mitte kalibrieren: Stick beim Start in Ruhe (ANNAHME) */
		for (int i = 0; i < 8; i++) {
			(void)read_mv(&ax, &sx[i]);
			(void)read_mv(&ay, &sy[i]);
		}
		if (!stick_axis_cal_center(&cx, sx, 8) || !stick_axis_cal_center(&cy, sy, 8)) {
			LOG_WRN("Stick-Mitte unplausibel, Default 1.65 V");
		}
		k_work_schedule(&stick_work, K_MSEC(EXT_POLL_IDLE_MS));
	} else {
		(void)gpio_pin_configure_dt(&ext4, GPIO_DISCONNECTED); /* kein Pull-up-Strom ohne Platine */
	}
	/* Touch auch ohne Stick: EXT5 hat Pull-down, offen -> low, keine Flanken */
	gpio_init_callback(&touch_cb, touch_isr, BIT(ext5.pin));
	(void)gpio_add_callback(ext5.port, &touch_cb);
	(void)gpio_pin_interrupt_configure_dt(&ext5, GPIO_INT_EDGE_BOTH);
	LOG_INF("J5 Bedienplatine %s", present ? "erkannt" : "nicht erkannt");
	return 0;
}

void ext_input_suspend(void)
{
	(void)gpio_pin_interrupt_configure_dt(&ext5, GPIO_INT_DISABLE);
	(void)k_work_cancel_delayable(&stick_work);
	(void)k_work_cancel_delayable(&touch_work);
}

/* Bis zur Festlegung im erweiterten Kanal (docs/EXTENDED_CHANNEL.md) nur Log; ueberschreibbar. */
__weak void ext_publish_stick(int8_t x, int8_t y, bool btn) { LOG_DBG("stick %d %d %d", x, y, btn); }
__weak void ext_publish_touch(bool down) { LOG_INF("touch %s", down ? "down" : "up"); }
```

## src/ui.c
```c
/* LED (PWM RGB), Summer (PWM Frequenzmodus), Vibrationsmotor, Taster. Adapter: Zephyr. */
#include <zephyr/kernel.h>
#include <zephyr/logging/log.h>
#include <zephyr/drivers/pwm.h>
#include <zephyr/drivers/gpio.h>
#include "app.h"

LOG_MODULE_REGISTER(ui, LOG_LEVEL_INF);

static const struct pwm_dt_spec led[3] = {PWM_DT_SPEC_GET(DT_ALIAS(led_red)), PWM_DT_SPEC_GET(DT_ALIAS(led_green)),
					  PWM_DT_SPEC_GET(DT_ALIAS(led_blue))};
static const struct pwm_dt_spec buzzer = PWM_DT_SPEC_GET(DT_ALIAS(buzzer));
static const struct gpio_dt_spec btn = GPIO_DT_SPEC_GET(DT_ALIAS(sw0), gpios);
static const struct gpio_dt_spec vib = GPIO_DT_SPEC_GET(DT_ALIAS(vib0), gpios);
static struct gpio_callback btn_cb;
static thingy_button_t btn_sm;
static thingy_led_cmd_t led_cur;
static uint32_t breathe_step;

#define BTN_POLL_MS 20u
#define BREATHE_STEPS 50u

static void led_rgb(uint8_t r, uint8_t g, uint8_t b)
{
	const uint8_t v[3] = {r, g, b};
	for (int i = 0; i < 3; i++) {
		(void)pwm_set_pulse_dt(&led[i], (uint32_t)((uint64_t)led[i].period * v[i] / 255u));
	}
}

static void led_mix(uint8_t mix, uint32_t level255)
{
	led_rgb((mix & 1) ? level255 : 0, (mix & 2) ? level255 : 0, (mix & 4) ? level255 : 0);
}

static void led_anim(struct k_work *w);
static K_WORK_DELAYABLE_DEFINE(led_work, led_anim);

static void led_anim(struct k_work *w)
{
	ARG_UNUSED(w);
	const uint32_t max = led_cur.intensity_pct * 255u / 100u;
	if (led_cur.mode == THINGY_LED_ONE_SHOT) {
		led_mix(led_cur.color_mix, 0);
		return;
	}
	/* Dreieck auf/ab, Periode delay_ms */
	const uint32_t s = breathe_step++ % (2 * BREATHE_STEPS);
	const uint32_t lvl = (s < BREATHE_STEPS ? s : 2 * BREATHE_STEPS - s) * max / BREATHE_STEPS;
	led_mix(led_cur.color_mix, lvl);
	k_work_schedule(&led_work, K_MSEC(MAX(led_cur.delay_ms / (2 * BREATHE_STEPS), 1u)));
}

void ui_led_apply(const thingy_led_cmd_t *cmd)
{
	(void)k_work_cancel_delayable(&led_work);
	led_cur = *cmd;
	switch (cmd->mode) {
	case THINGY_LED_CONSTANT:
		led_rgb(cmd->r, cmd->g, cmd->b);
		break;
	case THINGY_LED_BREATHE:
		breathe_step = 0;
		k_work_schedule(&led_work, K_NO_WAIT);
		break;
	case THINGY_LED_ONE_SHOT:
		led_mix(cmd->color_mix, cmd->intensity_pct * 255u / 100u);
		k_work_schedule(&led_work, K_MSEC(1000)); /* ANNAHME 1 s Blitz */
		break;
	default:
		led_rgb(0, 0, 0);
		break;
	}
}

static void buzzer_off(struct k_work *w)
{
	ARG_UNUSED(w);
	(void)pwm_set_dt(&buzzer, buzzer.period, 0);
	ble_publish_speaker_done();
}
static K_WORK_DELAYABLE_DEFINE(buzzer_work, buzzer_off);

void ui_speaker_tone(const thingy_speaker_tone_t *t)
{
	if (t->freq_hz == 0 || t->volume_pct == 0 || t->duration_ms == 0) {
		k_work_reschedule(&buzzer_work, K_NO_WAIT);
		return;
	}
	const uint32_t period = PWM_HZ(t->freq_hz);
	/* Lautstaerke ueber Tastgrad, max. 50 % (ANNAHME, Summer-Kennlinie unbekannt) */
	const uint32_t pulse = (uint32_t)((uint64_t)period * t->volume_pct / 200u);
	(void)pwm_set_dt(&buzzer, period, pulse);
	k_work_reschedule(&buzzer_work, K_MSEC(t->duration_ms));
}

static void vib_off(struct k_work *w)
{
	ARG_UNUSED(w);
	(void)gpio_pin_set_dt(&vib, 0);
}
static K_WORK_DELAYABLE_DEFINE(vib_work, vib_off);

void ui_vibrate_ms(uint32_t ms)
{
	(void)gpio_pin_set_dt(&vib, 1);
	k_work_reschedule(&vib_work, K_MSEC(ms));
}

static void btn_poll(struct k_work *w);
static K_WORK_DELAYABLE_DEFINE(btn_work, btn_poll);

static void btn_poll(struct k_work *w)
{
	ARG_UNUSED(w);
	const bool pressed = gpio_pin_get_dt(&btn) > 0;
	static bool last;
	if (pressed != last) {
		last = pressed;
		ble_publish_button(pressed);
	}
	switch (thingy_button_update(&btn_sm, pressed, k_uptime_get_32())) {
	case THINGY_BTN_EVT_LONG:
		imu_request_calibration();
		ui_vibrate_ms(150);
		break;
	default:
		break;
	}
	if (pressed) {
		k_work_schedule(&btn_work, K_MSEC(BTN_POLL_MS));
	}
}

static void btn_isr(const struct device *d, struct gpio_callback *cb, uint32_t pins)
{
	k_work_reschedule(&btn_work, K_MSEC(5)); /* Entprellen */
}

int ui_arm_button_wakeup(void)
{
	return gpio_pin_interrupt_configure_dt(&btn, GPIO_INT_LEVEL_ACTIVE);
}

int ui_init(void)
{
	thingy_button_init(&btn_sm);
	for (int i = 0; i < 3; i++) {
		if (!pwm_is_ready_dt(&led[i])) {
			return -ENODEV;
		}
	}
	if (!pwm_is_ready_dt(&buzzer) || !gpio_is_ready_dt(&btn) || !gpio_is_ready_dt(&vib)) {
		return -ENODEV;
	}
	(void)gpio_pin_configure_dt(&vib, GPIO_OUTPUT_INACTIVE);
	(void)gpio_pin_configure_dt(&btn, GPIO_INPUT);
	gpio_init_callback(&btn_cb, btn_isr, BIT(btn.pin));
	(void)gpio_add_callback(btn.port, &btn_cb);
	(void)gpio_pin_interrupt_configure_dt(&btn, GPIO_INT_EDGE_BOTH);
	led_rgb(0, 0, 0);
	return 0;
}
```
